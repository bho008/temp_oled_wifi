#ifndef I2C_H
#define I2C_H

#include <avr/pgmspace.h>
#include <avr/io.h>
#include <Arduino.h>
#include <stdlib.h>
//#include "data.c"

void i2c_OLED_send_cmd(uint8_t);
void sendcommand(unsigned char);
void clear_display(void);
void SendChar(unsigned char);
void setXY(unsigned char row,unsigned char col);
void sendStr( const char *string);
void sendFloat(double, int);
void init_OLED(void);
void i2c_init();
void i2c_OLED_init(void);
void i2c_OLED_send_byte(uint8_t);
void waitTransmissionI2C();

unsigned char myFont[][8]={
	{0x00,0x00,0x00,0x00,0x00,0x00,0x00,0x00},
	{0x00,0x00,0x5F,0x00,0x00,0x00,0x00,0x00},
	{0x00,0x00,0x07,0x00,0x07,0x00,0x00,0x00},
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	{0x00,0x02,0x05,0x05,0x02,0x00,0x00,0x00}
};

#define OLED_address  0x3c
#define INTERNAL_I2C_PULLUPS
static uint32_t neutralizeTime = 0;
static int16_t  i2c_errors_count = 0;




// ************************************************************************************************************
// I2C general functions
// ************************************************************************************************************




#define I2C_SPEED 100000L     //100kHz normal mode, this value must be used for a genuine WMP

#define I2C_PULLUPS_ENABLE         PORTC |= 1<<4; PORTC |= 1<<5;   // PIN A4&A5 (SDA&SCL)
#define I2C_PULLUPS_DISABLE        PORTC &= ~(1<<4); PORTC &= ~(1<<5);

void i2c_init(void) {
	#if defined(INTERNAL_I2C_PULLUPS)
	I2C_PULLUPS_ENABLE
	#else
	I2C_PULLUPS_DISABLE
	#endif
	TWSR = 1;                                    // no prescaler => prescaler = 1
	TWBR = ((F_CPU / I2C_SPEED) - 16) / 2;   // change the I2C clock rate
	TWCR = 1<<TWEN;                              // enable twi module, no interrupt
}

void init_OLED(void)
{
	i2c_OLED_init();
}

void  i2c_OLED_init(void){
	i2c_OLED_send_cmd(0xae);    //display off
	i2c_OLED_send_cmd(0x2e);    //deactivate scrolling
	i2c_OLED_send_cmd(0xa4);          //SET All pixels OFF
	//  i2c_OLED_send_cmd(0xa5);            //SET ALL pixels ON
	delay(50);
	i2c_OLED_send_cmd(0x20);            //Set Memory Addressing Mode
	i2c_OLED_send_cmd(0x02);            //Set Memory Addressing Mode to Page addressing mode(RESET)
	//  i2c_OLED_send_cmd(0xa0);      //colum address 0 mapped to SEG0 (POR)*** wires at bottom
	i2c_OLED_send_cmd(0xa1);    //colum address 127 mapped to SEG0 (POR) ** wires at top of board
	//  i2c_OLED_send_cmd(0xC0);            // Scan from Right to Left (POR)         *** wires at bottom
	i2c_OLED_send_cmd(0xC8);          // Scan from Left to Right               ** wires at top
	i2c_OLED_send_cmd(0xa6);            // Set WHITE chars on BLACK backround

	//  i2c_OLED_send_cmd(0xa7);            // Set BLACK chars on WHITE backround
	i2c_OLED_send_cmd(0x81);            // 81 Setup CONTRAST CONTROL, following byte is the contrast Value
	i2c_OLED_send_cmd(0xff);            // af contrast value between 1 ( == dull) to 256 ( == bright)
	delay(20);
	i2c_OLED_send_cmd(0xaf);          //display on
	delay(20);
}

//==========================================================//
void sendStr(const char *string)
{
	unsigned char i=0;
	//setXY(0,0);
	while(*string)
	{
		for(i=0;i<8;i++)
		{
			SendChar(myFont[*string-0x20][i]);

			// SendChar(*string);
			delay(1);
		}
		*string++;
	}
}

void sendFloat(double input, int precision){
	int int_input = (int)input;
	char sendFloatBuff[10];
	itoa(int_input, sendFloatBuff, 10);
	//sendStr(sendFloatBuff);
	
	char x[50];
	sprintf(x,"%5.5d",input);
	sendStr(x);
	
	/*
	if(precision > 0){
		sendStr(".");
		
		
		double frac;
		long mult = 1;
		byte padding = precision -1;
		while(precision--)
		mult *=10;
		
		if(input >= 0)
		frac = (input - int_input) * mult;
		else
		frac = (int_input- input ) * mult;
		unsigned long frac1 = frac;
		while( frac1 /= 10 )
		padding--;
		while(  padding--)
		sendStr("0");
		itoa(frac1, sendFloatBuff, 10);
		sendStr(sendFloatBuff);
	
	}
	*/
}

//==========================================================//
void SendChar(unsigned char data)
{
	i2c_OLED_send_byte(data);
}

//==========================================================//
void sendcommand(unsigned char com)
{
	i2c_OLED_send_cmd(com);
}


//==========================================================//
void setXY(unsigned char row,unsigned char col)
{
	sendcommand(0xb0+row);                //set page address
	sendcommand(0x00+(8*col&0x0f));       //set low col address
	sendcommand(0x10+((8*col>>4)&0x0f));  //set high col address
}
void clear_display(void)
{
	unsigned char i,k;
	for(k=0;k<8;k++)
	{
		setXY(k,0);
		{
			for(i=0;i<128;i++)     //clear all COL
			{
				SendChar(0);         //clear all COL
				//delay(10);
			}
		}
	}
}


void i2c_rep_start(uint8_t address) {
	TWCR = (1<<TWINT) | (1<<TWSTA) | (1<<TWEN) ; // send REPEAT START condition
	waitTransmissionI2C();                       // wait until transmission completed
	TWDR = address;                              // send device address
	TWCR = (1<<TWINT) | (1<<TWEN);
	waitTransmissionI2C();                       // wail until transmission completed
}

void i2c_stop(void) {
	TWCR = (1 << TWINT) | (1 << TWEN) | (1 << TWSTO);
	//  while(TWCR & (1<<TWSTO));                // <- can produce a blocking state with some WMP clones
}

void i2c_write(uint8_t data ) {
	TWDR = data;                                 // send data to the previously addressed device
	TWCR = (1<<TWINT) | (1<<TWEN);
	waitTransmissionI2C();
}

uint8_t i2c_read(uint8_t ack) {
	TWCR = (1<<TWINT) | (1<<TWEN) | (ack? (1<<TWEA) : 0);
	waitTransmissionI2C();
	uint8_t r = TWDR;
	if (!ack) i2c_stop();
	return r;
}

uint8_t i2c_readAck() {
	return i2c_read(1);
}

uint8_t i2c_readNak(void) {
	return i2c_read(0);
}

void waitTransmissionI2C() {
	uint16_t count = 255;
	while (!(TWCR & (1<<TWINT))) {
		count--;
		if (count==0) {              //we are in a blocking state => we don't insist
			TWCR = 0;                  //and we force a reset on TWINT register
			//neutralizeTime = micros(); //we take a timestamp here to neutralize the value during a short delay
			i2c_errors_count++;
			break;
		}
	}
}

size_t i2c_read_to_buf(uint8_t add, void *buf, size_t size) {
	i2c_rep_start((add<<1) | 1);	// I2C read direction
	size_t bytes_read = 0;
	uint8_t *b = (uint8_t*)buf;
	while (size--) {
		/* acknowledge all but the final byte */
		*b++ = i2c_read(size > 0);
		/* TODO catch I2C errors here and abort */
		bytes_read++;
	}
	return bytes_read;
}

size_t i2c_read_reg_to_buf(uint8_t add, uint8_t reg, void *buf, size_t size) {
	i2c_rep_start(add<<1); // I2C write direction
	i2c_write(reg);        // register selection
	return i2c_read_to_buf(add, buf, size);
}

/* transform a series of bytes from big endian to little
endian and vice versa. */
void swap_endianness(void *buf, size_t size) {
	/* we swap in-place, so we only have to
	* place _one_ element on a temporary tray
	*/
	uint8_t tray;
	uint8_t *from;
	uint8_t *to;
	/* keep swapping until the pointers have assed each other */
	for (from = (uint8_t*)buf, to = &from[size-1]; from < to; from++, to--) {
		tray = *from;
		*from = *to;
		*to = tray;
	}
}

void i2c_writeReg(uint8_t add, uint8_t reg, uint8_t val) {
	i2c_rep_start(add<<1); // I2C write direction
	i2c_write(reg);        // register selection
	i2c_write(val);        // value to write in register
	i2c_stop();
}


void i2c_OLED_send_cmd(uint8_t command) {
	TWBR = ((F_CPU / 400000L) - 16) / 2; // change the I2C clock rate
	i2c_writeReg(OLED_address, 0x80, (uint8_t)command);
}

void i2c_OLED_send_byte(uint8_t val) {
	TWBR = ((F_CPU / 400000L) - 16) / 2; // change the I2C clock rate
	i2c_writeReg(OLED_address, 0x40, (uint8_t)val);
}


#endif