//==========================================================//
//-------------------------WWW.WIDE.HK----------------------//
//-----i2c OLED example-------------------------------------//
//-----Function : show 128x64 Graphic , Word and animation--//
//-----SCL = A5  ,  SDA = A4 , VCC = 3.3V-5V , GND----------//
//==========================================================//

#include "oled_setup.h"
//---------------FONT + GRAPHIC-----------------------------//
//#include "data.c"
//==========================================================//

char buffer[8];

unsigned char fill_OLED=0x55;
unsigned char fill_string1[]="OLED Code";
unsigned char fill_string2[]="OLED 128*64";
unsigned char fill_string3[]="ABC 123";
unsigned char fill_string4[]="Arduino 328";
unsigned char myFont[][8] = {
//prog_uchar myFont[][8] PROGMEM ={
{0x00,0x00,0x00,0x00,0x00,0x00,0x00,0x00},
{0x00,0x00,0x5F,0x00,0x00,0x00,0x00,0x00},
{0x00,0x00,0x07,0x00,0x07,0x00,0x00,0x00},
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{0x00,0x02,0x05,0x05,0x02,0x00,0x00,0x00} 
};

//==========================================================//
void OLED_I2C::print_a_char(unsigned char ascii=0)
{
  unsigned char i=0;
  for(i=0;i<8;i++)
  {
    //SendChar(myFont[ascii-0x20][i]);
    SendChar(pgm_read_word(&myFont[ascii-0x20][i]));
  }
}

//==========================================================//
void OLED_I2C::init()
{

//  Wire.begin();
  i2c_init();
  init_OLED();
  delay(10);
  clear_display();
  delay(50);
}

/*

//==========================================================//
void loop()
{
  clear_display();
  delay(50);

  sendcommand(0x20);            //Set Memory Addressing Mode
  sendcommand(0x02);            //Set Memory Addressing Mode ab Page addressing mode(RESET)  

  sendcommand(0xa6);            //Set Normal Display (default)
  //====================SHOW FONTS ARRAY[1-4]=======================//
  setXY(0,0);
  sendStr(fill_string1);
  setXY(3,3);
  sendStr(fill_string2);
  setXY(4,3);
  sendStr(fill_string3);
  setXY(5,3);
  sendStr(fill_string4);
 
  delay(2000);
  //sendStr(logo);
  delay(2000);
  /*
  sendcommand(0xa7);  //Set Inverse Display  
  delay(2000);

  clear_display();
  delay(50);  

  sendcommand(0xa6);  //Set Normal Display

  sendcommand(0xae);		//display off
  sendcommand(0x20);            //Set Memory Addressing Mode
  sendcommand(0x00);            //Set Memory Addressing Mode ab Horizontal addressing mode


//==========================================================//
  for(int i=0;i<128*8;i++)     // show 128* 64 picture
  {
    SendChar(logo[i]);
  }
//==========================================================//


  sendcommand(0xaf);
  delay(2000);
  sendcommand(0xa7);    //Set Inverse Display
  delay(2000);  

  while(1)
  {
    //sendcommand(0xa6);  Set Normal Display
    sendcommand(0x29);  //Vertical and Horizontal Scroll Setup
    sendcommand(0x00);  //dummy byte
    sendcommand(0x00);  //define page0 as startpage address
    sendcommand(0x00);  //set time interval between each scroll ste as 6 frames
    sendcommand(0x07);  //define page7 as endpage address
    sendcommand(0x01);  //set vertical scrolling offset as 1 row
    sendcommand(0x2f);  //active scrolling
    delay(3000);

  };

}

*/

//==========================================================//
void OLED_I2C::sendcommand(unsigned char com)
{
  i2c_OLED_send_cmd(com);  
  /*
  Wire.beginTransmission(OLED_address);     //begin transmitting
  Wire.write(0x80);                          //command mode
  Wire.write(com);
  Wire.endTransmission();                    // stop transmitting
  */
}

//==========================================================//
void OLED_I2C::clear_display(void)
{
  unsigned char i,k;
  for(k=0;k<8;k++)
  {	
    setXY(k,0);    
    {
      for(i=0;i<128;i++)     //clear all COL
      {
        SendChar(0);         //clear all COL
        //delay(10);
      }
    }
  }
}

//==========================================================//
void OLED_I2C::SendChar(unsigned char data)
{
  i2c_OLED_send_byte(data);
  /*
  Wire.beginTransmission(OLED_address); // begin transmitting
  Wire.write(0x40);//data mode
  Wire.write(data);
  Wire.endTransmission();    // stop transmitting
  */
}

//==========================================================//
void OLED_I2C::setXY(unsigned char row,unsigned char col)
{
  sendcommand(0xb0+row);                //set page address
  sendcommand(0x00+(8*col&0x0f));       //set low col address
  sendcommand(0x10+((8*col>>4)&0x0f));  //set high col address
}


//==========================================================//
void OLED_I2C::sendStr(unsigned char *string)
{
  unsigned char i=0;
  //setXY(0,0);    
  while(*string)
  {
    for(i=0;i<8;i++)
    {
      //SendChar(myFont[*string-0x20][i]);
      SendChar(pgm_read_word(&myFont[*string-0x20][i]));
     
      delay(10);
    }
    *string++;
  }
}

//==========================================================//
void OLED_I2C::init_OLED(void)
{
i2c_OLED_init();

}

void OLED_I2C::i2c_OLED_init(void){
  i2c_OLED_send_cmd(0xae);    //display off
  i2c_OLED_send_cmd(0x2e);    //deactivate scrolling
  i2c_OLED_send_cmd(0xa4);          //SET All pixels OFF
//  i2c_OLED_send_cmd(0xa5);            //SET ALL pixels ON
  delay(50);
  i2c_OLED_send_cmd(0x20);            //Set Memory Addressing Mode
  i2c_OLED_send_cmd(0x02);            //Set Memory Addressing Mode to Page addressing mode(RESET)
//  i2c_OLED_send_cmd(0xa0);      //colum address 0 mapped to SEG0 (POR)*** wires at bottom
  i2c_OLED_send_cmd(0xa1);    //colum address 127 mapped to SEG0 (POR) ** wires at top of board
//  i2c_OLED_send_cmd(0xC0);            // Scan from Right to Left (POR)         *** wires at bottom
  i2c_OLED_send_cmd(0xC8);          // Scan from Left to Right               ** wires at top
  i2c_OLED_send_cmd(0xa6);            // Set WHITE chars on BLACK backround

 // i2c_OLED_send_cmd(0xa7);            // Set BLACK chars on WHITE backround
  i2c_OLED_send_cmd(0x81);            // 81 Setup CONTRAST CONTROL, following byte is the contrast Value
  i2c_OLED_send_cmd(0xff);            // af contrast value between 1 ( == dull) to 256 ( == bright)
  delay(20);
  i2c_OLED_send_cmd(0xaf);          //display on
  delay(20);
}


